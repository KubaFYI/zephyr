## prj.conf
```kconfig
CONFIG_SDI_12=y
CONFIG_LOG=y
```

## boards/adafruit_feather_m0_basic_proto.overlay
```dts
/* 
 * Copyritght 2020: R3-IoT Ltd.
 * Licence: Apache 2.0
 */

&sercom1 {
	status = "okay";
	compatible = "atmel,sam0-uart";
	current-speed = <1200>;
	rxpo = <1>;
	txpo = <3>;
};
```

## src/main.c
```c
/*
 * Copyright (c) 2019 R3 IoT Ltd.
 *
 * License: Apache-2.0
 *
 * An example app using the SDI-12 subsystem for sensor interaction.
*/
```
